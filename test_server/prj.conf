## CMakeLists.txt
```
# SPDX-License-Identifier: Apache-2.0

add_compile_options(-ldl -lpcap)
set(CMAKE_C_FLAGS "${CMAKE_C_FLAGS} -lpcap")

cmake_minimum_required(VERSION 3.20.0)

find_package(Zephyr REQUIRED HINTS $ENV{ZEPHYR_BASE})
project(sockets_echo)

FILE(GLOB app_sources src/*.c)
target_sources(app PRIVATE ${app_sources})

include(${ZEPHYR_BASE}/samples/net/common/common.cmake)
```

## prj.conf
```kconfig
# General config
CONFIG_NEWLIB_LIBC=y
CONFIG_MAIN_STACK_SIZE=1200

# Networking config
CONFIG_NETWORKING=y
CONFIG_NET_IPV4=y
CONFIG_NET_IPV6=y
CONFIG_NET_TCP=y
CONFIG_NET_SOCKETS=y
CONFIG_NET_SOCKETS_POSIX_NAMES=n

# Network driver config
CONFIG_TEST_RANDOM_GENERATOR=y

# Network address config
CONFIG_NET_CONFIG_SETTINGS=y
CONFIG_NET_CONFIG_NEED_IPV4=y
CONFIG_NET_CONFIG_MY_IPV4_ADDR="192.0.2.1"
CONFIG_NET_CONFIG_PEER_IPV4_ADDR="192.0.2.2"

# Enable ASAN
CONFIG_ASAN=y

CONFIG_NET_SOCKETS_PACKET=y

CONFIG_NET_TC_RX_COUNT=0
CONFIG_NET_TC_TX_COUNT=0

CONFIG_LOG=y
CONFIG_NET_LOG=y
CONFIG_PRINTK=y
CONFIG_NET_CONFIG_LOG_LEVEL_DBG=y

CONFIG_TIMESLICING=y
CONFIG_TIMESLICE_SIZE=10
CONFIG_TIMESLICE_PRIORITY=0

CONFIG_THREAD_NAME=y
CONFIG_USERSPACE=y
```

## src/in.h
```c
int read_input(void *buf, unsigned long buf_len);
int network_interface_init(void);
```

## src/netif.c
```c
#include "netif.h"

pcap_t *interface;


pcap_t* set_interface_modes(pcap_t* interface_handler){
    int ret;
    log_debug("Setting device modes of operation on network interface");
    ret = pcap_set_promisc(interface_handler, 1);
    if((ret != 0) && (ret != PCAP_ERROR_ACTIVATED)){
        log_error("couldn't not activate promisuous mode\n");
        return NULL;
    }
    ret = pcap_set_snaplen(interface_handler, 1222);
    if((ret != 0) && (ret != PCAP_ERROR_ACTIVATED)) {
        log_error("couldn't not set snaplen\n");
        return NULL;
    }
    ret = pcap_set_timeout(interface_handler, 200);
    if((ret != 0) && (ret != PCAP_ERROR_ACTIVATED)) {
        log_error("couldn't not set timeout\n");
        return NULL;
    }
    ret = pcap_set_buffer_size(interface_handler, 1222 * 1100);
    if((ret != 0) && (ret != PCAP_ERROR_ACTIVATED)) {
        log_error("couldn't not set buffer size\n" );
        return NULL;
    }
    return interface_handler;
}


pcap_t* open_interface(char* interface_name) {
    char error_buffer[256];
    pcap_t *interface_handler = pcap_create(interface_name, error_buffer);
    if(interface_handler == NULL) {
        log_error("The interface %s is not supported by pcap and cannot be opened: %s\n", interface_name, error_buffer);
        return NULL;
    }
    interface_handler = set_interface_modes(interface_handler);
    if(interface_handler == NULL) {
        log_error("Error configuring Interface");
        return NULL;
    }
    if(pcap_activate(interface_handler) != 0) {
        log_error("pcap activate error %s\n", pcap_geterr(interface_handler));
        return NULL;
    }
    return interface_handler;
}

void print_hex(unsigned const char * const bin_data, size_t len){
    size_t i;
    for(i = 0; i < len; i++){
        printf("%.2X ", bin_data[i]);
    }
    printf("\n");
}

void pcap_callback(unsigned char * user, const struct pcap_pkthdr *pkt_header, const unsigned char *pkt_data) {
    log_info("Receiving <=  network callback user: %s len: %d caplen: %d\n", user, pkt_header->len, pkt_header->caplen);
    print_hex(pkt_data, pkt_header->len);
    
    process_packet_packetdrill((void*)pkt_data, pkt_header->len);

}

int print_output(void *p, int len){
    if(len > 0) {
        printk("Sending => data send package %li \n ", len);
        print_hex((unsigned const char *)p, len);
        if(interface == NULL){
            return 0;
        }
        if(pcap_sendpacket(interface, p, len) != 0 ){
            printk("pcap_sendpackeet: send failed\n");
            return 0;
        }
    }
    return len;
}

int read_input(void *buf, unsigned long buf_len){
    unsigned char* buffer = buf;
    struct pcap_pkthdr *header;
    const unsigned char *packet;
    int res = pcap_next_ex(interface, &header, &packet);
    if(res == 0){
        return 0;
    }
    for(int i = 0; i < header->caplen; i++){
        *(buffer + i) = *(packet + i);
    }
    
    if(res == 1){
        return header->len;
    }else{
        return 0;
    }
}

int network_interface_init(void){
    char* interface_name = getenv("TAP_INTERFACE_NAME");
    pcap_t *interface_handler = open_interface(interface_name);
    interface = interface_handler;
    if(interface_handler == NULL) {
        log_error("Error opening interface \"%s\"", getenv("TAP_INTERFACE_NAME"));
        exit(EXIT_FAILURE);
    }
    char errbuf[PCAP_ERRBUF_SIZE];
    if (pcap_setnonblock(interface, 1, errbuf) == -1) {
        log_error("Error setting non-blocking mode: %s\n", errbuf);
        exit(EXIT_FAILURE);
    }  
    return pcap_get_selectable_fd(interface_handler);
}
```

## src/netif.h
```c
#include <pthread.h>
#include <pcap/pcap.h>
#include <stdio.h>
#include <stdlib.h>
#include <string.h>
#include <unistd.h>
#include <errno.h>

#include <zephyr/net/net_core.h>


#include "log.h"
```

## src/out.h
```c
int print_output(void *p, int len);
```

## src/portability_layer.c
```c
#include <sys/types.h>
#include <sys/socket.h>
#include <sys/un.h>
#include <netinet/in.h>
#include <stdlib.h>
#include <string.h>
#include <errno.h>
#include <unistd.h>


#include "portability_layer.h"
#include "log.h"

char *getSocketName() {
    char *socket_name;
    const char *interface_name = getenv("TAP_INTERFACE_NAME");
    if (interface_name != NULL) {
        int len = strlen(interface_name) + strlen("/tmp/socket-") + 1;
        socket_name = malloc(len * sizeof(char));
        snprintf(socket_name, len, "/tmp/socket-%s", interface_name);
    } else {
        socket_name = strdup("/tmp/socket-default");
    }
    return socket_name;
}

void run_syscalls(struct packetdrill_syscalls *interface){

    log_info("Creating socket to Paketdrill");
    char *socket_name = getSocketName();
    unlink(socket_name);
    int sfd = socket(AF_UNIX, SOCK_STREAM, 0);
    if(sfd == -1){
        log_error("Error creating socket to Packetdrill");
        exit(EXIT_FAILURE);
    }
    log_info("Socket to Paketdrill created");

    log_info("Binding ports in socket to Paketdrill");
    struct sockaddr_un addr;
    memset(&addr, 0, sizeof(struct sockaddr_un));
    addr.sun_family = AF_UNIX;
    strcpy(addr.sun_path, socket_name);
    free(socket_name);
    if(bind(sfd, (struct sockaddr *)&addr, sizeof(struct sockaddr_un)) == -1){
        log_error("Error binding Packetdrill socket to port");
        exit(EXIT_FAILURE);
    }
    log_info("Ports to Paketdrill bound");

    log_info("Listening for incoming connection from Packetdrill ...");
    if (listen(sfd, 1) == -1) {
        log_error("Error listening on Packedrill socket");
        exit(EXIT_FAILURE);
    }

    for(;;){
        int cfd = accept(sfd, NULL, NULL);
        if(cfd == -1){
            log_error("Error accepting connection from PacketDrill");
            exit(EXIT_FAILURE);
        }

        log_info("Conection accepted");
        ssize_t numRead = 0;
        struct SyscallPackage syscallPackage;
        while ((numRead = read(cfd, &syscallPackage, sizeof(struct SyscallPackage))) > 0) {
            if (syscallPackage.bufferedMessage == 1) {
                void *buffer = malloc(syscallPackage.bufferedCount);
                ssize_t bufferCount = read(cfd, buffer, syscallPackage.bufferedCount);
                if (bufferCount <= 0) {
                    printf("Error reading buffer content from socket\n");
                } else if (bufferCount != syscallPackage.bufferedCount) {
                    printf("Count of buffer not equal to expected count.\n");
                } else {
                    printf("Successfully read buffer count from socket.\n");
                }
                syscallPackage.buffer = buffer;
            }

            log_info("Packetdrill command received: %s", syscallPackage.syscallId);

            struct SyscallResponsePackage syscallResponse;
            int result = 0;
            if(strcmp(syscallPackage.syscallId, "socket_create") == 0){
                result = interface->socket_syscall(syscallPackage.socketPackage.domain);
            } else if (strcmp(syscallPackage.syscallId, "socket_bind") == 0) {
                result = interface->bind_syscall(syscallPackage.bindPackage.sockfd, syscallPackage.bindPackage.addr.sin_port);
            } else if (strcmp(syscallPackage.syscallId, "socket_listen") == 0) {
                result = interface->listen_syscall(syscallPackage.listenPackage.sockfd);
            } else if (strcmp(syscallPackage.syscallId, "socket_accept") == 0) {
                struct SyscallResponsePackage response;
                response = interface->accept_syscall(syscallPackage.acceptPackage.sockfd);
                result = response.result;
                syscallResponse.acceptResponse = response.acceptResponse;
            } else if (strcmp(syscallPackage.syscallId, "socket_connect") == 0) {
                result = interface->connect_syscall(syscallPackage.connectPackage.sockfd, syscallPackage.connectPackage.addr.sin_addr, syscallPackage.connectPackage.addr.sin_port);
            } else if (strcmp(syscallPackage.syscallId, "socket_write") == 0) {
                result = interface->write_syscall(syscallPackage.writePackage.sockfd, syscallPackage.buffer, syscallPackage.bufferedCount);
            } else if (strcmp(syscallPackage.syscallId, "socket_read") == 0) {
                result = interface->read_syscall(syscallPackage.readPackage.sockfd);
            } else if (strcmp(syscallPackage.syscallId, "socket_close") == 0){
                result = interface->close_syscall(syscallPackage.closePackage.sockfd);
            } else if (strcmp(syscallPackage.syscallId, "freertos_init") == 0) {
                result = interface->init_syscall();
            }

            log_info("Syscall response buffer received: %d...\n", syscallResponse.result);
            syscallResponse.result = result;
            
            ssize_t numWrote = send(cfd, &syscallResponse, sizeof(struct SyscallResponsePackage), MSG_NOSIGNAL);
            if (numWrote == -1) {
                log_error("Error writing socket response with errno %d...\n", errno);
            } else {
                log_info("Successfully wrote socket response to Packetdrill...\n");
            }
            if(syscallPackage.bufferedMessage == 1){
                free(syscallPackage.buffer);
            }
            if(strcmp(syscallPackage.syscallId, "socket_accept") == 0){
                result = interface->accepted_callback();
            }
            if(strcmp(syscallPackage.syscallId, "socket_listen") == 0){
                result = interface->listened_callback();
            }
            if(strcmp(syscallPackage.syscallId, "socket_close") == 0){
                result = interface->closed_callback();
            }
        }
        if(numRead == 0){
            log_info("Execution completed!");
            log_info("About to unlink socket");
            if(close(cfd) == -1){
                log_error("Error closing socket\n");
                //exit(EXIT_FAILURE);
            }
            //exit(EXIT_SUCCESS);
        }else if(numRead == -1){
            log_error("Error reading from socket\n");
            //exit(EXIT_FAILURE);
        }

    }

}
```

## src/portability_layer.h
```c
#include <netinet/in.h>


#ifndef __PORTABILITY_LAYER_H__
#define __PORTABILITY_LAYER_H__

struct SocketPackage {
    int domain;
    int type;
    int protocol;
};

struct AcceptPackage {
    int sockfd;
};

struct BindPackage {
    int sockfd;
    union {
        struct sockaddr_in addr;
        struct sockaddr_in6 addr6;
    };
    socklen_t addrlen;
};

struct ListenPackage {
    int sockfd;
    int backlog;
};

struct ConnectPackage {
    int sockfd;
    union {
        struct sockaddr_in addr;
        struct sockaddr_in6 addr6;
    };
    socklen_t addrlen;
};

struct WritePackage {
    int sockfd;
    size_t count;
};

struct SendToPackage {
    int sockfd;
    int flags;
    union {
        struct sockaddr_in addr;
        struct sockaddr_in6 addr6;
    };
    socklen_t addrlen;
};

struct ReadPackage {
    int sockfd;
    size_t count;
};

struct RecvFromPackage {
    int sockfd;
    size_t count;
    int flags;
};

struct ClosePackage {
    int sockfd;
};

struct AcceptResponsePackage {
    union {
        struct sockaddr_in addr;
        struct sockaddr_in6 addr6;
    };

    socklen_t addrlen;
};

struct SyscallResponsePackage {
    int result;
    union {
        struct AcceptResponsePackage acceptResponse;
    };
};


struct SyscallPackage {
    char syscallId[20];
    int bufferedMessage;
    size_t bufferedCount;
    void *buffer;
    union {
        struct SocketPackage socketPackage;
        struct BindPackage bindPackage;
        struct ListenPackage listenPackage;
        struct AcceptPackage acceptPackage;
        struct BindPackage connectPackage;
        struct WritePackage writePackage;
        struct SendToPackage sendToPackage;
        struct ClosePackage closePackage;
        struct ReadPackage readPackage;
        struct RecvFromPackage recvFromPackage;
    };
};

struct packetdrill_syscalls {
    int (*socket_syscall)(int domain);
    int (*bind_syscall)(int index, unsigned short int port);
    int (*listen_syscall)(int index);
    struct SyscallResponsePackage (*accept_syscall)(int index);
    int (*connect_syscall)(int index, struct in_addr address, unsigned short int port);
    int (*write_syscall)(int index, void *buffer, unsigned long size);
    int (*read_syscall)(int index);
    int (*close_syscall)(int index);
    int (*init_syscall)(void);
    int (*accepted_callback)(void);
    int (*listened_callback)(void);
    int (*closed_callback)(void);

};

//typedef void (*packetdrill_run_syscalls_fn)(struct packetdrill_syscalls*);
void run_syscalls(struct packetdrill_syscalls *interface);



#endif /*__PORTABILITY_LAYER_H__*/
```

## src/socket_echo.c
```c
#include <zephyr/kernel.h>

#include "portability_layer.h"
#include "netif.h"
#include "zephyr.h"



#define MAX_SOCKET_ARRAY 10
int socketArray[MAX_SOCKET_ARRAY];
int socketCounter = 3;
int ip_version;
unsigned short int port_global;


int reset_socket_array(void){
    int sizeSocketArray = socketCounter - 3;
    if (sizeSocketArray > 0) {
        int counter;
        for (counter = 3; counter < socketCounter; counter++) {
            int *pcb = &socketArray[counter];
            zephyr_close(*pcb);
        }
        memset(socketArray, 0, MAX_SOCKET_ARRAY * sizeof(int));
    }
    socketCounter = 3;
    printk("PacketDrill Handler Task Reset..\n");
    return sizeSocketArray;
}


int socket_syscall(int domain){
    printk("Socket create in Zephyr\n");
    int serv;
    serv = zephyr_socket(domain);
    //ip_version = domain == AF_INET ? 4 : 6;
    ip_version = 4;
    if (serv < 0) {
        printk("Error in \"socket_create\" instruction");
        return -1;
    } else {
        socketArray[socketCounter] = serv;
        return socketCounter++;
    }
}

int bind_syscall(int index, unsigned short int port){
    printk("Socket bind in Zephyr\n");
    //struct sockaddr_in bind_addr;
    int serv = socketArray[index];
    /*bind_addr.sin_family = AF_INET;
    bind_addr.sin_addr.s_addr = htonl(INADDR_ANY);
    bind_addr.sin_port = htons(port);*/
    if (zephyr_bind(serv, port) < 0) {
        printk("Error: bind: %d\n", errno);
        return -1;
    } else {
        port_global = port;
        return 0;
    }
}

int listen_syscall(int index){
    printk("Socket listen in Zephyr\n");
    int serv = socketArray[index];
    if (zephyr_listen(serv) < 0) {
        printk("Error in \"socket_listen\" instruction");
        return -1;
    } else {
        return 0;
    }
}
struct SyscallResponsePackage accept_syscall(int index){
    printk("Socket accept in Zephyr\n");
    struct SyscallResponsePackage syscallResponse;
    int serv = socketArray[index];
    int response;
    struct sockaddr_in client_addr;
    struct sockaddr_in6 client_addr_6;
    socklen_t client_addr_len = sizeof(client_addr);
    unsigned short int port;
    printk("About to sleep in accept...\n");
    int client = zephyr_accept(serv, &port);
    printk("Waking up from accept...\n");
    if (client < 0) {
        printk("error: accept: %d\n", errno);
    }
    socketArray[socketCounter] = client;
    response = socketCounter;
    socketCounter++;
    struct AcceptResponsePackage acceptResponse;
    if (ip_version == 6) {
        struct sockaddr_in6 addr;
        addr.sin6_family = AF_INET6;
        addr.sin6_port = htons(port_global);
        memcpy(&addr.sin6_addr, &client_addr_6.sin6_addr, sizeof(struct in6_addr));
        acceptResponse.addr6 = addr;
        acceptResponse.addrlen = sizeof(struct sockaddr_in6);
    } else {
        struct sockaddr_in addr;
        addr.sin_family = AF_INET;
        addr.sin_port = port;
        addr.sin_addr.s_addr = inet_addr("192.0.2.2");
        //memcpy(&addr.sin_addr, &client_addr.sin_addr, sizeof(struct in_addr));
        acceptResponse.addr = addr;
        acceptResponse.addrlen = sizeof(struct sockaddr_in);
    }
    syscallResponse.result = response;
    syscallResponse.acceptResponse = acceptResponse;
    k_sleep(K_MSEC(50));
    //k_yield();
    return syscallResponse;
}


int connect_syscall(int index, struct in_addr address, unsigned short int port){
    printk("Socket connect in Zephyr\n");
    struct in_addr dest_ipaddr;
    int serv = socketArray[index];
    memcpy(&dest_ipaddr, &address, sizeof(struct in_addr));
    if (zephyr_connect(serv, &address) < 0) {
        printk("Error in \"socket_connect\" instruction\n");
        return -1;
    } else {
        return 0;
    }
    return 0;
}

int read_syscall(int index){
    printk("Socket connect in Zephyr\n");
    int serv = socketArray[index];
    int len = zephyr_read(serv);
    if (len < 0) {
        printk("Error in \"socket_read\" instruction");
        return -1;
    }
    return 0;
}
int write_syscall(int index, void *buffer, unsigned long size){
    printk("Socket connect in Zephyr\n");
    int response;
    int serv = socketArray[index];
    response = zephyr_write(serv, buffer, size);
    if (response < 0) {
        printk("Error in \"socket_write\" instruction");
        return -1;
    }
    return 0;
}
int close_syscall(int index){
    zephyr_close(socketArray[index]);
    return 0;
}
int init_syscall(){
    return reset_socket_array();
}

int listened_callback(){
    k_sleep(K_MSEC(800));
    k_yield();
    return 0;
}

int accepted_callback(){
    k_sleep(K_MSEC(800));
    k_yield();
    return 0;
}

int closed_callback(){
    k_sleep(K_MSEC(800));
    k_yield();
    return 0;
}

void main(void){
    struct packetdrill_syscalls args;
    args.socket_syscall = socket_syscall;
    args.bind_syscall = bind_syscall;
    args.listen_syscall = listen_syscall;
    args.accept_syscall = accept_syscall;
    args.connect_syscall = connect_syscall;
    args.write_syscall = write_syscall;
    args.read_syscall = read_syscall;
    args.close_syscall = close_syscall;
    args.init_syscall = init_syscall;
    args.accepted_callback = accepted_callback;
    args.listened_callback = listened_callback;
    args.closed_callback = closed_callback;
    run_syscalls(&args);
}
```

## src/zephyr.c
```c
#include "zephyr.h"

#include <zephyr/net/socket.h>

int zephyr_socket(int domain){
    return zsock_socket(AF_INET, SOCK_STREAM, IPPROTO_TCP);
}

int zephyr_bind(int fd, unsigned short int port){
    struct sockaddr_in bind_addr;
    bind_addr.sin_family = AF_INET;
    bind_addr.sin_addr.s_addr = INADDR_ANY;
    bind_addr.sin_port = port;
    return zsock_bind(fd, (struct sockaddr *)&bind_addr, sizeof(bind_addr));
}

int zephyr_listen(int fd){
    return zsock_listen(fd, 5);
}

int zephyr_accept(int fd, unsigned short int *port){
    struct sockaddr_in client_addr;
    socklen_t client_addr_len = sizeof(client_addr);
    int result = zsock_accept(fd, (struct sockaddr *)&client_addr, &client_addr_len);
    *port = client_addr.sin_port;
    return result;
}

int zephyr_connect(int fd, unsigned int *addr){
    return zsock_connect(fd, &addr, sizeof(unsigned int));
}

int zephyr_read(int fd){
    char buf[128];
    return zsock_recv(fd, buf, sizeof(buf), 0);
}

int zephyr_write(int fd, void* buffer, unsigned long size){
    return zsock_send(fd, buffer, size, 0);
}

int zephyr_close(int fd){
    return zsock_close(fd);
}
```

## src/zephyr.h
```c
int zephyr_socket(int domain);
int zephyr_bind(int fd, unsigned short int port);
int zephyr_listen(int fd);
int zephyr_accept(int fd, unsigned short int *port);
int zephyr_connect(int fd, unsigned int *addr);
int zephyr_read(int fd);
int zephyr_write(int fd, void* buffer, unsigned long size);
int zephyr_close(int fd);
```
